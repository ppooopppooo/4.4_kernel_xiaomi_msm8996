## drivers/platform/xiaomi/Kconfig
```kconfig
# Xiaomi configuration options

config MACH_XIAOMI_MSM8996
	bool "Xiaomi MSM8996 device"
	depends on ARCH_MSM8996
	help
	  Support for MSM8996 Xiaomi devices

choice
	prompt "Xiaomi board selection"
	depends on MACH_XIAOMI_MSM8996

config MACH_XIAOMI_A1
	bool "A1 board"
	help
	 Support for Xiaomi Mi 5, codenamed gemini.

config MACH_XIAOMI_A4
	bool "A4 board"
	help
	 Support for Xiaomi Mi Note2, codenamed scorpio.
	 
config MACH_XIAOMI_A7
	bool "A7 board"
	help
	 Support for Xiaomi Mi 5s, codenamed capricorn.

config MACH_XIAOMI_A8
	bool "A8 board"
	help
	 Support for Xiaomi Mi Mix, codenamed lithium.

config MACH_XIAOMI_B7
	bool "B7 board"
	help
	 Support for Xiaomi Mi 5sPlus, codenamed natrium.
	 
endchoice
```
